#include <SPI.h>
#include <WiFly.h>  //use https://github.com/dubhunter/WiFly-Shield/tree/client-hardening
#include <LedControl.h>   // http://playground.arduino.cc/Main/LedControl
char ssid[] = "";
char pass[] = "";  
char host[] = "";  //host hosting the php helper stuff
const unsigned long requestInterval = 30000;  // delay between requests
unsigned long lastAttemptTime = 0;            // last time you connected to the server, in milliseconds
String currentLine = "";            // string to hold the text from server
String tweet = "Booting...";                  // string to hold the tweet
boolean readingTweet = false;      
boolean readingUser = false;
const int devCount = 4;
int brightness = 15;
int curcharix = 0;
int curcharbit = 0;
int curcharixsave = 0;
int curcharbitsave = 0;
int curcharixsave2 = 0;
int curcharbitsave2 = 0;
char curchar;
char msg[170] = "Booting...";  //ugly hack to insure msg array is primed regardless of when timer fires
int msgsize =  strlen(msg);
PROGMEM byte Font8x5[104*8] =
        {0x00, 0x00, 0x00, 0x00, 0x00, 0x00, 0x00, 0x00, 
        0x02, 0x02, 0x02, 0x02, 0x02, 0x00, 0x02, 0x00,
        0x05, 0x05, 0x05, 0x00, 0x00, 0x00, 0x00, 0x00,
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        0x1C, 0x22, 0x45, 0x49, 0x41, 0x22, 0x1C, 0x00,
};
PROGMEM byte lentbl_S[104] =
{
        2, 2, 3, 5, 5, 5, 5, 2, 
        3, 3, 5, 5, 2, 5, 1, 5, 
        5, 4, 5, 5, 5, 5, 5, 5, 
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        7, 7, 7, 7, 7, 7, 7, 7
};
// initialize the library instance:
WiFlyClient client(host, 80);
// LedControl(DIN,CLK,LOAD,devCount)
LedControl lc = LedControl(6,7,8,devCount); 

void setup() {
  // reserve space for the strings:
  currentLine.reserve(170);
  tweet.reserve(170);
  WiFly.begin();
  if (!WiFly.join(ssid, pass)) {
    tweet = "WiFI failed.";
    while (1) {
      // Hang on failure.
    }
  }  
  //we have to init all devices in a loop
  for(int address=0;address<devCount;address++) {
    /*The MAX72XX is in power-saving mode on startup*/
    lc.shutdown(address,false);
    /* Set the brightness to a medium values */
    lc.setIntensity(address,brightness);
    /* and clear the display */
    lc.clearDisplay(address);
  }  
  // initialize Timer1
  cli();          // disable global interrupts
  TCCR1A = 0;     // set entire TCCR1A register to 0
  TCCR1B = 0;     // same for TCCR1B
  // set compare match register to desired timer count:
  OCR1A = 800;
  // turn on CTC mode:
  TCCR1B |= (1 << WGM12);
  // Set CS10 and CS12 bits for 1024 prescaler:
  TCCR1B |= (1 << CS10);
  TCCR1B |= (1 << CS12);
  // enable timer compare interrupt:
  TIMSK1 |= (1 << OCIE1A);
  sei();          // enable global interrupts
  // connect to Twitter:
  connectToServer();  
}

void loop() {
  if (client.connected()) {
    if (client.available()) {
      // read incoming bytes:
      char inChar = client.read();
      // if you get a newline, clear the line:
      if (inChar == '\n') {
        currentLine = "";
      }
      // add incoming byte to end of line:
      currentLine += inChar; 
      // if you're currently reading the bytes of a user,
      // add them to the tweet String:
      if (readingUser) {
        if (inChar != '<') {
          if (inChar != '\\') tweet += inChar; //nuke escapes
        } 
        else {
          // if you got a "<" character,
          // you've reached the end of the user:
          readingUser = false;
          tweet += ": ";
        }
      }
      // if you're currently reading the bytes of a tweet,
      // add them to the tweet String:
      if (readingTweet) {
        if (inChar != '<') {
          if (inChar != '\\') tweet += inChar; //nuke escapes
        } 
        else {
          // if you got a "<" character,
          // you've reached the end of the tweet:
          readingTweet = false;
          // close the connection to the server:
          client.stop(); 
        }
      }
      // if the current stream ends with <user>, it will
      // be followed by the user:
      if ( currentLine.endsWith("<user>")) {
        // user is beginning. Clear the tweet string:
        readingUser = true; 
        tweet = "***";
      }
      // if the current stream ends with <tweet>, it will
      // be followed by the tweet:
      if ( currentLine.endsWith("<tweet>")) {
        // tweet is beginning.
        readingTweet = true; 
      }      
    }
  }
  else if (millis() - lastAttemptTime > requestInterval) {
    // Throttle twitter calls
    connectToServer();
  }
}

void connectToServer() {
  // attempt to connect, and wait a millisecond:
  if (client.connect()) {
    // make HTTP GET request to twitter:
    client.print(F("GET /tweet.php HTTP/1.1\n"));
    client.print(F("HOST: "));
    client.print(host);
    client.print(F("\n"));
    client.print(F("User-Agent: Arduino/1.0\n"));
    client.println();
  }
  else tweet = "Twitter timeout.";
  // note the time of this connect attempt:
  lastAttemptTime = millis();
}   

ISR(TIMER1_COMPA_vect) {
  int i,j,k;
  curcharixsave2 = curcharix;
  curcharbitsave2 = curcharbit;
  for (i=devCount-1;i>=0;i--) {  // Loop through our 8 displays
    for (j=0;j<8;j++) {  // Set up rows on current  display      
      byte outputbyte = 0;
      curchar = msg[curcharix];
      curcharixsave = curcharix;
      curcharbitsave = curcharbit;
      for (k=7;k>=0;k--) {  // Copy over data for 8 columns to current row and send it to current display
        // This byte is the bitmap of the current character for the current row
        byte currentcharbits = pgm_read_byte(&Font8x5[((curchar-32)*8)+j]);
        if (currentcharbits & (1<<curcharbit)) outputbyte |= (1<<k);     
        // advance the current character bit of current character
        curcharbit ++;
        if (curcharbit > pgm_read_byte(&lentbl_S[curchar-32])) {  // we are past the end of this character, so advance.
          curcharbit = 0;
          curcharix += 1;          
          if (curcharix+1 > msgsize) {  // current message done - load new tweet
            curcharix=0;
            tweet.replace("\n:","");  //strip twitter's stupid line feeds
            tweet.toCharArray(msg, tweet.length()+1);
            msgsize =  strlen(msg);
          }
          curchar = msg[curcharix];
        }
      }
      lc.setRow(i, j, outputbyte);
      if (j != 7) // if this is not the last row, roll back advancement, if it is, leave the counters advanced.
      {
        curcharix = curcharixsave;
        curcharbit = curcharbitsave;
      }
    }
  }
  curcharix = curcharixsave2;
  curcharbit = curcharbitsave2;
  curchar = msg[curcharix];
  // advance the current character bit of current character
  curcharbit ++;
  if (curcharbit > pgm_read_byte(&lentbl_S[curchar-32])) {  // we are past the end of this character, so advance.
    curcharbit = 0;
    curcharix += 1;
    if (curcharix+1 > msgsize) curcharix=0;
    curchar = msg[curcharix];
  }  
}

